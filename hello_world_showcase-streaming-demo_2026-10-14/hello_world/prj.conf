## CMakeLists.txt
```
# SPDX-License-Identifier: Apache-2.0

cmake_minimum_required(VERSION 3.20.0)

find_package(Zephyr REQUIRED HINTS $ENV{ZEPHYR_BASE})
project(hello_world)

# ADC->BLE/RTT pipeline, ported from nrf5340_firmware (that project's
# state-machine/inference-only files are deliberately not carried over).
target_sources(app PRIVATE
	src/main.c
	src/ble_sender.c
	src/rtt_sender.c
	src/sm_core.c
	src/sampling_source.c
	src/sampling_source_nrfx.c
	src/sm_ble_bridge.c
)
```

## Kconfig
```
mainmenu "hello_world (ADC->BLE pipeline test)"

menu "ADC->BLE pipeline parameters (HW-only, do not treat as validated)"

config SM_SAMPLE_RATE_HR_HZ
	int "PULSE_WINDOW sample rate for heart-rate windows (Hz)"
	default 200
	help
	  Unused by this project (PULSE_WINDOW is never entered here — see
	  main.c), kept only because sampling_source.c/sampling_source_nrfx.c
	  were ported unmodified from nrf5340_firmware and still reference
	  it for sm_window_profiles[]/buffer sizing.

config SM_SAMPLE_RATE_BP_HZ
	int "PULSE_WINDOW sample rate for blood-pressure/PTT windows (Hz)"
	default 1000
	help
	  Unused by this project, same reason as SM_SAMPLE_RATE_HR_HZ above.

config SM_SAMPLE_RATE_ACTIVITY_HZ
	int "ACTIVE_CAPTURE sample rate (Hz)"
	default 500
	help
	  The rate actually used: this project's state machine is locked
	  into ACTIVE_CAPTURE for the whole session (see main.c).
	  ble_sender.c streams live (see its own header comment) rather than
	  buffering a session in RAM, so this needs to stay within BLE's
	  actual sustained throughput or ble_sender.c's TX queue will start
	  dropping windows — real-hardware testing put sustained throughput
	  at roughly 14-15 fragments/s post-connection; at
	  BLE_SM_SAMPLES_PER_PKT=50 (see ble_sender.c) this rate needs 2
	  fragments per 100-sample window, so 500 Hz's 5 windows/s (10
	  frag/s) has real margin where 1000 Hz's 10 windows/s (20 frag/s)
	  did not. HW-only: real value TBD once front-end requirements are
	  confirmed — do not treat as final.

config SM_PULSE_WINDOW_MS
	int "PULSE_WINDOW duration (ms)"
	default 3000
	help
	  Unused by this project (PULSE_WINDOW is never entered here), kept
	  because sampling_source_nrfx.c still sizes its pulse_buf[] from it.

config SM_SILENCE_TIMEOUT_MS
	int "ACTIVE_CAPTURE silence timeout (ms)"
	default 86400000
	help
	  How long without a fresh EV_ACTIVITY before ACTIVE_CAPTURE exits
	  back to DEEP_IDLE. Deliberately set to 24 hours (vs.
	  nrf5340_firmware's 2000 ms default) so this simplified pipeline's
	  single boot-time EV_ACTIVITY kick (see main.c) keeps it sampling
	  for the whole session — nothing here ever posts a follow-up
	  EV_ACTIVITY the way sm_event_injection.c does in the source
	  project. sm_core.c's actual exit logic is untouched; this just
	  keeps it from ever firing in practice.

config SM_ACTIVITY_CHUNK_SAMPLES
	int "ACTIVE_CAPTURE ping-pong chunk size (samples per channel)"
	default 100
	help
	  How many samples (per channel) fill one ping-pong buffer before
	  EV_BUF_READY fires. Trade-off between handoff latency and
	  per-buffer overhead — HW-only, real value TBD.

endmenu

source "Kconfig.zephyr"
```

## sysbuild.conf
```
# Minimal sysbuild config to build+flash the network core (cpunet) ipc_radio
# image alongside the app core image — required for BLE on nRF5340. Ported
# from nrf5340_firmware (originally copied from
# nrf/samples/bluetooth/peripheral_uart/sysbuild/ipc_radio/prj.conf's setup).
SB_CONFIG_NETCORE_IPC_RADIO=y
SB_CONFIG_NETCORE_IPC_RADIO_BT_HCI_IPC=y
```

## prj.conf
```kconfig
CONFIG_USE_SEGGER_RTT=y
CONFIG_RTT_CONSOLE=y
CONFIG_UART_CONSOLE=n
CONFIG_SERIAL=n

CONFIG_LOG=y
CONFIG_LOG_BACKEND_RTT=y
CONFIG_LOG_BACKEND_UART=n
CONFIG_LOG_MODE_IMMEDIATE=y
# Default 1024 B wraps fast enough at this project's ~100ms log cadence
# that J-Link RTT Viewer/JLinkRTTLogger can miss early boot lines before
# it finishes attaching. 16384 gives enough headroom that a normal
# attach delay never loses them.
CONFIG_SEGGER_RTT_BUFFER_SIZE_UP=16384

# ── ADC->BLE pipeline (ported from nrf5340_firmware) ───────────────────────
# nrfx SAADC direct driver (sampling_source_nrfx.c) — not Zephyr's generic
# ADC API.
CONFIG_NRFX_SAADC=y
CONFIG_NRFX_TIMER=y
CONFIG_NRFX_GPPI=y
CONFIG_GPIO=y

CONFIG_PM_DEVICE=y
CONFIG_PM_DEVICE_RUNTIME=y

# ── BLE ──────────────────────────────────────────────────────────────────
CONFIG_BT=y
CONFIG_BT_PERIPHERAL=y
CONFIG_BT_DEVICE_NAME="Device_ADC"
CONFIG_BT_MAX_CONN=1

# NUS service
CONFIG_BT_NUS=y

# nRF5340: use host PRNG, not HCI for entropy (required on this SoC)
CONFIG_BT_HOST_CRYPTO_PRNG=y
CONFIG_ENTROPY_BT_HCI=n

# 247 is the standard "DLE-friendly" ATT MTU (fits a 251-byte Data Length
# Extension Link Layer PDU with L2CAP/ATT overhead). One ble_sm_packet
# fragment (see ble_sender.c's BLE_SM_SAMPLES_PER_PKT) is 216 bytes,
# comfortably under the 244-byte usable ATT payload this gives.
CONFIG_BT_L2CAP_TX_MTU=247
CONFIG_BT_BUF_ACL_TX_SIZE=251
CONFIG_BT_BUF_ACL_RX_SIZE=251
CONFIG_BT_BUF_ACL_TX_COUNT=10
# zephyr/include/zephyr/bluetooth/buf.h build-asserts EVT_RX_COUNT >
# ACL_TX_COUNT (controller needs a free HCI event buffer per in-flight
# ACL TX completion, plus normal connection/advertising events).
CONFIG_BT_BUF_EVT_RX_COUNT=16

# GATT client role + auto MTU exchange: we're a peripheral, but still need
# to actively request the ATT MTU above on connect — without this the link
# sits at BLE's default 23-byte MTU until something asks for more, and nRF
# Connect / most phones only respond, they don't always initiate first.
CONFIG_BT_GATT_CLIENT=y
CONFIG_BT_GATT_AUTO_UPDATE_MTU=y

# CONFIG_BT_GAP_AUTO_UPDATE_CONN_PARAMS defaults to y and re-requests
# connection parameters ~5s after every connect using whatever
# CONFIG_BT_PERIPHERAL_PREF_MIN_INT/MAX_INT say (Zephyr defaults: 30-50ms).
# Pinned here to match ble_sender.c's fast_conn_param
# (BT_LE_CONN_PARAM_INIT(8, 16, 0, 400)) so that automatic re-request
# agrees with connected()'s explicit one instead of undoing it.
CONFIG_BT_PERIPHERAL_PREF_MIN_INT=8
CONFIG_BT_PERIPHERAL_PREF_MAX_INT=16
CONFIG_BT_PERIPHERAL_PREF_LATENCY=0
CONFIG_BT_PERIPHERAL_PREF_TIMEOUT=400

# Data Length Extension (bigger Link Layer PDUs) and 2M PHY, both
# negotiated automatically once enabled — PHY is also requested
# explicitly in ble_sender.c's connected() (CONFIG_BT_AUTO_PHY_UPDATE is
# deprecated in this Zephyr version).
CONFIG_BT_USER_DATA_LEN_UPDATE=y
CONFIG_BT_AUTO_DATA_LEN_UPDATE=y
CONFIG_BT_USER_PHY_UPDATE=y

# DK LEDs: LED2 = BLE connection status (ble_sender.c)
CONFIG_DK_LIBRARY=y

# ── System ───────────────────────────────────────────────────────────────
CONFIG_HEAP_MEM_POOL_SIZE=2048
CONFIG_SYSTEM_WORKQUEUE_STACK_SIZE=2048
CONFIG_ASSERT=y

# LFXO (external 32.768kHz crystal), for BLE long-connection-interval power
# efficiency — nRF5340 DK / BT40F module both have it on-board.
CONFIG_CLOCK_CONTROL_NRF_K32SRC_XTAL=y
```

## boards/nrf5340dk_nrf5340_cpuapp.overlay
```dts
/*
 * SPDX-License-Identifier: Apache-2.0
 *
 * Ported from nrf5340_firmware's board overlay (ADC->BLE pipeline subset).
 */

/* Just "okay" + explicit compatible so the node exists and is clocked for
 * direct nrfx_saadc access from sampling_source_nrfx.c (no Zephyr-ADC-API
 * channel@N bindings needed — that driver talks to the SAADC peripheral
 * directly). */
&adc {
	status = "okay";
	compatible = "nordic,nrf-saadc";
};

/* BT40F module (this hardware) has no external QSPI NOR flash — see the
 * matching fix in nrf5340_firmware's overlay. Without this, boot logs
 * "qspi_nor: JEDEC id [ff ff ff] expect [c2 28 17]" probing a chip that
 * was never populated. */
&qspi {
	status = "disabled";
};
```

## src/main.c
```c
/*
 * SPDX-License-Identifier: Apache-2.0
 *
 * ADC -> BLE/RTT pipeline test firmware. Wiring layer only, ported/trimmed
 * from nrf5340_firmware's main.c: same ble_sender_init() / sm_core_init()
 * / sm_ble_bridge_init() call sequence, minus that project's random-forest
 * inference self-test and DK-button state-machine event injection.
 * rtt_sender_init() adds a second, wired transport (see rtt_sender.h) —
 * sm_ble_bridge.c feeds both from the same delivered windows.
 *
 * sm_core.c is carried over byte-for-byte from nrf5340_firmware (see its
 * own header) and normally starts cold in DEEP_IDLE, only leaving it on
 * an externally-posted EV_ACTIVITY/EV_PULSE_DUE — usually DK-button
 * injected there. This project doesn't port that button-injection module
 * (sm_event_injection.c), so instead: the one sm_post_event() call below
 * gives it that same kick once at boot to enter ACTIVE_CAPTURE, and
 * Kconfig's SM_SILENCE_TIMEOUT_MS is set large enough (24h) that it
 * never times back out to DEEP_IDLE during a normal session — net
 * effect, continuous ADC sampling streamed live over BLE/RTT for as
 * long as the board is powered, without touching sm_core.c's transition
 * logic at all.
 */

#include <zephyr/kernel.h>
#include <zephyr/logging/log.h>

#include <hal/nrf_clock.h>

#include "ble_sender.h"
#include "rtt_sender.h"
#include "sm_core.h"
#include "sm_ble_bridge.h"
#include "sampling_source_nrfx.h"

LOG_MODULE_REGISTER(main, LOG_LEVEL_INF);

/* Prints which LFCLK source is actually running (nrf_clock_lf_srccopy_get()
 * reads the source latched at LFCLKSTART, not just what's configured).
 * CONFIG_CLOCK_CONTROL_NRF_K32SRC_XTAL=y (prj.conf) only pins what Zephyr
 * *asks* the clock to start as — this confirms it's actually running on
 * XTAL and not silently falling back to RC. */
static void log_lfclk_source(void)
{
	nrf_clock_lfclk_t src = nrf_clock_lf_srccopy_get(NRF_CLOCK);
	const char *name;

	switch (src) {
	case NRF_CLOCK_LFCLK_XTAL:
		name = "XTAL (LFXO, external 32.768kHz crystal) — expected";
		break;
	case NRF_CLOCK_LFCLK_RC:
		name = "RC (LFRC, internal) — NOT the configured source, check crystal/board";
		break;
	case NRF_CLOCK_LFCLK_SYNTH:
		name = "SYNTH (derived from HFCLK) — NOT the configured source";
		break;
	default:
		name = "UNKNOWN";
		break;
	}
	LOG_INF("LFCLK running source: %s (raw=0x%x)", name, (unsigned int)src);
}

int main(void)
{
	int err;

	log_lfclk_source();

	err = ble_sender_init();
	if (err) {
		LOG_ERR("ble_sender_init: %d", err);
		return err;
	}

	rtt_sender_init();

	sampling_source_nrfx_install();
	sm_core_init();

	/* See file header: the only kick this simplified pipeline needs to
	 * move sm_core.c out of its cold DEEP_IDLE start. */
	sm_post_event(&(struct sm_event){ .type = EV_ACTIVITY });

	sm_ble_bridge_init();

	LOG_INF("ADC->BLE/RTT pipeline up, advertising as \"%s\"", CONFIG_BT_DEVICE_NAME);

	return 0;
}
```

## src/ble_sender.c
```c
/* SPDX-License-Identifier: Apache-2.0
 *
 * BLE sender module. Single direction: NUS TX only; RX callback is NULL.
 *
 * Real-time design: sm_ble_bridge.c queues each window here as soon as
 * sm_core.c delivers it (ble_sender_queue_sm_window()); ble_sm_tx_thread_fn
 * below drains that queue and sends fragments as fast as BLE allows. If the
 * queue fills up (BLE running behind production), the oldest queued window
 * is dropped and counted rather than blocking the producer — same
 * backpressure policy as sm_core.c's own delivery queue. This trades
 * completeness for staying live: for hour-scale unattended captures, RAM
 * usage has to stay flat regardless of session length, which a
 * capture-then-drain design (this project's earlier approach) cannot do —
 * see git history for that version and why it was replaced.
 */

#include "ble_sender.h"
#include "sampling_source.h"

#include <stddef.h>
#include <string.h>
#include <zephyr/kernel.h>
#include <zephyr/sys/util.h>
#include <zephyr/bluetooth/bluetooth.h>
#include <zephyr/bluetooth/uuid.h>
#include <zephyr/bluetooth/gatt.h>
#include <zephyr/bluetooth/hci.h>
#include <bluetooth/services/nus.h>
#include <dk_buttons_and_leds.h>
#include <zephyr/logging/log.h>

LOG_MODULE_REGISTER(ble_sender, LOG_LEVEL_DBG);

#define CON_STATUS_LED  DK_LED2

#define DEVICE_NAME     CONFIG_BT_DEVICE_NAME
#define DEVICE_NAME_LEN (sizeof(DEVICE_NAME) - 1)

/* ── BLE state ────────────────────────────────────────────────────────────── */

static struct bt_conn *current_conn;
static struct k_work   adv_work;

static const struct bt_data ad[] = {
	BT_DATA_BYTES(BT_DATA_FLAGS, (BT_LE_AD_GENERAL | BT_LE_AD_NO_BREDR)),
	BT_DATA(BT_DATA_NAME_COMPLETE, DEVICE_NAME, DEVICE_NAME_LEN),
};

static const struct bt_data sd[] = {
	BT_DATA_BYTES(BT_DATA_UUID128_ALL, BT_UUID_NUS_VAL),
};

/* ── Connection callbacks ─────────────────────────────────────────────────── */

static const struct bt_le_conn_param fast_conn_param =
	BT_LE_CONN_PARAM_INIT(8, 16, 0, 400);

static void adv_work_handler(struct k_work *work)
{
	ARG_UNUSED(work);
	int err = bt_le_adv_start(BT_LE_ADV_CONN_FAST_2,
				  ad, ARRAY_SIZE(ad),
				  sd, ARRAY_SIZE(sd));
	if (err) {
		LOG_ERR("adv start failed: %d", err);
	}
}

static void connected(struct bt_conn *conn, uint8_t err)
{
	char addr[BT_ADDR_LE_STR_LEN];

	bt_addr_le_to_str(bt_conn_get_dst(conn), addr, sizeof(addr));
	if (err) {
		LOG_ERR("connect failed %s err 0x%02x", addr, err);
		return;
	}
	LOG_INF("connected %s", addr);
	current_conn = bt_conn_ref(conn);
	dk_set_led_on(CON_STATUS_LED);

	int param_err = bt_conn_le_param_update(conn, &fast_conn_param);

	if (param_err) {
		LOG_WRN("bt_conn_le_param_update request: %d", param_err);
	}

	int phy_err = bt_conn_le_phy_update(conn, BT_CONN_LE_PHY_PARAM_2M);

	if (phy_err) {
		LOG_WRN("bt_conn_le_phy_update request: %d", phy_err);
	}
}

static void disconnected(struct bt_conn *conn, uint8_t reason)
{
	char addr[BT_ADDR_LE_STR_LEN];

	bt_addr_le_to_str(bt_conn_get_dst(conn), addr, sizeof(addr));
	LOG_INF("disconnected %s reason 0x%02x", addr, reason);

	if (current_conn) {
		bt_conn_unref(current_conn);
		current_conn = NULL;
		dk_set_led_off(CON_STATUS_LED);
	}
}

static void recycled_cb(void)
{
	k_work_submit(&adv_work);
}

BT_CONN_CB_DEFINE(conn_callbacks) = {
	.connected          = connected,
	.disconnected       = disconnected,
	.recycled           = recycled_cb,
};

/* RX path intentionally absent: single-direction design. */
static struct bt_nus_cb nus_cb = {
	.received = NULL,
};

/* ── State-machine window queue ──────────────────────────────────────────── */

/* Deliberately independent of sampling_source.h's SM_ADC_NUM_CHANNELS
 * (currently also 2, but has been widened as high as 6 for past channel-
 * mapping debugging — see sampling_source.h) — BLE only ever needs the
 * first BLE_SM_TX_NUM_CHANNELS of each sample, picked out of win.raw[]'s
 * SM_ADC_NUM_CHANNELS-wide interleaving in the copy loop below. Keeps the
 * BLE wire format/fragment size fixed independent of how many channels the
 * ADC itself is sampling, in case that changes again. */
#define BLE_SM_TX_NUM_CHANNELS 2
BUILD_ASSERT(BLE_SM_TX_NUM_CHANNELS <= SM_ADC_NUM_CHANNELS,
	     "can't send more channels over BLE than the ADC actually samples");

#define BLE_SM_SAMPLES_PER_PKT 50
#define BLE_SM_PACKET_TAG 0xA5

/* Size (full fragment, BLE_SM_TX_NUM_CHANNELS channels): 1(tag) +
 * 2(tx_seq) + 4(seq) + 4(timestamp_ms) + 1(window_type) + 4(sample_count)
 * + 1(complete) + 1(frag_idx) + 1(frag_count) + 1(raw_count) +
 * 200(raw, 50*2*2) = 220 bytes — fits the 244-byte usable ATT payload
 * (MTU 247 - 3 byte header) with 24 bytes to spare. */
struct __packed ble_sm_packet {
	uint8_t  tag;
	uint16_t tx_seq;
	uint32_t seq;
	uint32_t timestamp_ms;
	uint8_t  window_type;
	uint32_t sample_count;
	uint8_t  complete;
	uint8_t  frag_idx;
	uint8_t  frag_count;
	uint8_t  raw_count;
	int16_t  raw[BLE_SM_SAMPLES_PER_PKT * BLE_SM_TX_NUM_CHANNELS];
};

#define SM_TX_QUEUE_DEPTH 4

K_MSGQ_DEFINE(sm_tx_q, sizeof(struct sm_delivered_window), SM_TX_QUEUE_DEPTH, 4);
/* atomic_t: incremented from this file's own TX thread, read from
 * ble_sender_get_overflow_count() by whatever wants a health check (e.g.
 * during a long unattended capture) — see sm_core.c's matching
 * overflow_count for the other half of the pipeline (windows dropped
 * before ever reaching this queue). Never resets on its own. */
static atomic_t sm_tx_overflow_count;

/* Transport-level counter, separate from struct sm_delivered_window's
 * business seq (window identity — sm_core.c assigns it, has
 * design-intentional gaps whenever a window is dropped/preempted before
 * it ever reaches sm_tx_q). tx_seq only increments here, once per actual
 * wire packet (one per FRAGMENT, not one per window), so it is what the
 * PC side should use to detect real link loss: any gap in tx_seq as
 * received means a packet that really went out never arrived. uint16_t
 * wraps at 65536 — the PC script must treat that as normal, not loss. */
static uint16_t sm_tx_seq;

int ble_sender_queue_sm_window(const struct sm_delivered_window *win)
{
	if (k_msgq_put(&sm_tx_q, win, K_NO_WAIT) != 0) {
		struct sm_delivered_window dropped;

		if (k_msgq_get(&sm_tx_q, &dropped, K_NO_WAIT) == 0) {
			uint32_t n = (uint32_t)atomic_inc(&sm_tx_overflow_count) + 1;

			LOG_WRN("sm TX queue full, dropped window_seq=%u (overflow #%u)",
				dropped.meta.window_seq, n);
		}
		k_msgq_put(&sm_tx_q, win, K_NO_WAIT);
	}
	return 0;
}

uint32_t ble_sender_get_overflow_count(void)
{
	return (uint32_t)atomic_get(&sm_tx_overflow_count);
}

static void ble_sm_tx_thread_fn(void *a, void *b, void *c)
{
	ARG_UNUSED(a);
	ARG_UNUSED(b);
	ARG_UNUSED(c);

	struct sm_delivered_window win;

	while (1) {
		k_msgq_get(&sm_tx_q, &win, K_FOREVER);

		if (!current_conn) {
			/* Never attempted onto the air — does not consume a
			 * tx_seq, same as a window the state machine itself
			 * dropped before it ever reached sm_tx_q. Whole
			 * window skipped, not per-fragment: there's nowhere
			 * to send any of it. */
			LOG_INF("ble_tx: business_seq=%u dropped (no BLE connection)",
				win.meta.window_seq);
			continue;
		}

		uint8_t frag_count = DIV_ROUND_UP(win.raw_count, BLE_SM_SAMPLES_PER_PKT);

		for (uint8_t f = 0; f < frag_count; f++) {
			uint16_t offset = (uint16_t)f * BLE_SM_SAMPLES_PER_PKT;
			uint8_t this_count = (uint8_t)MIN(BLE_SM_SAMPLES_PER_PKT,
							   win.raw_count - offset);

			struct ble_sm_packet pkt = {
				.tag = BLE_SM_PACKET_TAG,
				.tx_seq = sm_tx_seq++,
				.seq = win.meta.window_seq,
				.timestamp_ms = win.meta.timestamp_ms,
				.window_type = (uint8_t)win.meta.window_type,
				.sample_count = win.meta.sample_count,
				.complete = win.meta.complete ? 1 : 0,
				.frag_idx = f,
				.frag_count = frag_count,
				.raw_count = this_count,
			};

			/* win.raw[] is interleaved SM_ADC_NUM_CHANNELS-wide;
			 * pkt.raw[] only wants the first BLE_SM_TX_NUM_CHANNELS
			 * of each sample, so this is a strided copy, not a
			 * single memcpy. */
			for (uint8_t s = 0; s < this_count; s++) {
				const int16_t *src = &win.raw[(size_t)(offset + s) *
							       SM_ADC_NUM_CHANNELS];
				int16_t *dst = &pkt.raw[(size_t)s * BLE_SM_TX_NUM_CHANNELS];

				memcpy(dst, src, BLE_SM_TX_NUM_CHANNELS * sizeof(int16_t));
			}

			size_t pkt_len = offsetof(struct ble_sm_packet, raw) +
					  (size_t)this_count * BLE_SM_TX_NUM_CHANNELS * sizeof(int16_t);

			/* Not retried on failure: this is live data, a stalled
			 * connection should not back up the whole pipeline
			 * waiting for one fragment. Still increments tx_seq
			 * above even on failure — a real send attempt that
			 * never reached the PC should show up as a gap on the
			 * PC side, not be silently invisible. */
			int err = bt_nus_send(NULL, (const uint8_t *)&pkt, pkt_len);

			if (err) {
				LOG_WRN("bt_nus_send tx_seq=%u business_seq=%u frag=%u/%u: %d",
					pkt.tx_seq, win.meta.window_seq, f + 1, frag_count, err);
			} else {
				LOG_INF("ble_tx: sent tx_seq=%u business_seq=%u frag=%u/%u raw_count=%u",
					pkt.tx_seq, win.meta.window_seq, f + 1, frag_count, this_count);
			}
		}
	}
}

/* struct sm_delivered_window win (~440 B at SM_DELIVERY_RAW_CAPACITY=100 *
 * SM_ADC_NUM_CHANNELS=2) + struct ble_sm_packet pkt (~220 B) per fragment,
 * plus bt_nus_send()'s call depth through L2CAP/HCI. 2048 matches this
 * project's established sizing for that call depth (see git history —
 * this exact thread has overflowed a smaller stack before). */
K_THREAD_DEFINE(ble_sm_tx_tid, 2048, ble_sm_tx_thread_fn, NULL, NULL, NULL, 7, 0, 0);

/* ── Public API ───────────────────────────────────────────────────────────── */

int ble_sender_init(void)
{
	int err;

	err = dk_leds_init();
	if (err) {
		LOG_ERR("dk_leds_init: %d", err);
		return err;
	}

	err = bt_enable(NULL);
	if (err) {
		LOG_ERR("bt_enable: %d", err);
		return err;
	}
	LOG_INF("BT enabled");

	err = bt_nus_init(&nus_cb);
	if (err) {
		LOG_ERR("bt_nus_init: %d", err);
		return err;
	}

	k_work_init(&adv_work, adv_work_handler);
	k_work_submit(&adv_work);

	return 0;
}
```

## src/ble_sender.h
```c
/* SPDX-License-Identifier: Apache-2.0 */
#ifndef BLE_SENDER_H_
#define BLE_SENDER_H_

#include <stdint.h>

#include "sampling_source.h"

/* Initialise BLE stack, NUS service, and start advertising.
 * Returns 0 on success, negative errno on failure. */
int ble_sender_init(void);

/* Queues one delivered window for real-time transmission. Non-blocking
 * (K_NO_WAIT). If the internal queue is full, drops the oldest queued
 * entry, counts an overflow, and logs a warning — same backpressure
 * policy as sm_core.c's own delivery queue. Never blocks the caller.
 * Always returns 0 (queueing always eventually succeeds by dropping
 * something); kept as int for API-evolution headroom. */
int ble_sender_queue_sm_window(const struct sm_delivered_window *win);

/* Cumulative count of windows dropped because the internal TX queue was
 * full (BLE side of any drop investigation — see sm_core.h's
 * sm_get_overflow_count() for the other half, windows dropped before
 * ever reaching this queue). Never resets on its own. */
uint32_t ble_sender_get_overflow_count(void);

#endif /* BLE_SENDER_H_ */
```

## src/rtt_sender.c
```c
/* SPDX-License-Identifier: Apache-2.0
 *
 * Streams full (unfragmented) ADC windows over a dedicated SEGGER RTT
 * up-channel — a wired alternative to ble_sender.c's BLE path, same
 * window data, different transport, live rather than batch: rides the
 * existing J-Link/SWD connection, no radio or connection-interval
 * involved.
 *
 * Channel 1 (channel 0 stays the Terminal/log channel used by
 * CONFIG_LOG_BACKEND_RTT) — SEGGER_RTT_Conf.h's default
 * SEGGER_RTT_MAX_NUM_UP_BUFFERS=3 already provides it, no Kconfig change
 * needed.
 *
 * Deliberately NOT fragmented like the BLE path: RTT isn't ATT-MTU-limited,
 * a whole window (up to RTT_SM_MAX_RAW_SAMPLES=100 samples * 2 channels =
 * 400 bytes raw, 416 with header) fits in one SEGGER_RTT_Write() call.
 *
 * SEGGER_RTT_MODE_NO_BLOCK_SKIP (this channel's mode, set in
 * rtt_sender_init()): if the host isn't reading fast enough and the ring
 * buffer doesn't have room, a write is dropped WHOLE — SEGGER_RTT_Write()
 * returns 0, nothing is partially written, nothing blocks — matching
 * sm_core.c/ble_sender.c's own "never block the producer" policy, just
 * enforced by the RTT library instead of a k_msgq.
 */
#include "rtt_sender.h"

#include <string.h>
#include <stddef.h>
#include <zephyr/kernel.h>
#include <zephyr/logging/log.h>

#include <SEGGER_RTT.h>

LOG_MODULE_REGISTER(rtt_sender, LOG_LEVEL_INF);

#define RTT_ADC_CHANNEL 1

/* One full window is up to 16(header) + 100*2*2(raw) = 416 bytes. Sized
 * for several windows' worth of slack even if the host briefly falls
 * behind, rather than tight. */
#define RTT_ADC_BUF_SIZE 4096

static uint8_t rtt_up_buffer[RTT_ADC_BUF_SIZE];

/* 0xA6 — deliberately different from ble_sender.c's BLE_SM_PACKET_TAG
 * (0xA5), so a byte-stream parser can never confuse the two transports'
 * framing even if pointed at the wrong channel/log by mistake. */
#define RTT_SM_PACKET_TAG 0xA6

struct __packed rtt_sm_packet {
	uint8_t  tag;
	uint32_t seq;
	uint32_t timestamp_ms;   /* device uptime (ms) when this window's last
				   * sample completed — see sampling_source.h's
				   * sm_buffer_meta */
	uint8_t  window_type;
	uint32_t sample_count;   /* whole window's true total */
	uint8_t  complete;
	uint8_t  raw_count;      /* samples in this packet, <= RTT_SM_MAX_RAW_SAMPLES */
	int16_t  raw[RTT_SM_MAX_RAW_SAMPLES * RTT_SM_NUM_CHANNELS];
};

void rtt_sender_init(void)
{
	SEGGER_RTT_ConfigUpBuffer(RTT_ADC_CHANNEL, "ADC_DATA", rtt_up_buffer,
				   sizeof(rtt_up_buffer), SEGGER_RTT_MODE_NO_BLOCK_SKIP);

	LOG_INF("RTT ADC data channel ready (channel %d, tag 0x%02x)",
		RTT_ADC_CHANNEL, RTT_SM_PACKET_TAG);
}

void rtt_sender_send_window(const struct rtt_sm_window_info *info)
{
	struct rtt_sm_packet pkt = {
		.tag = RTT_SM_PACKET_TAG,
		.seq = info->seq,
		.timestamp_ms = info->timestamp_ms,
		.window_type = info->window_type,
		.sample_count = info->sample_count,
		.complete = info->complete ? 1 : 0,
		.raw_count = info->raw_count,
	};

	memcpy(pkt.raw, info->raw,
	       (size_t)info->raw_count * RTT_SM_NUM_CHANNELS * sizeof(int16_t));

	size_t len = offsetof(struct rtt_sm_packet, raw) +
		     (size_t)info->raw_count * RTT_SM_NUM_CHANNELS * sizeof(int16_t);

	unsigned written = SEGGER_RTT_Write(RTT_ADC_CHANNEL, &pkt, len);

	if (written != len) {
		LOG_WRN("RTT ADC write dropped seq=%u (host not reading fast enough?)",
			info->seq);
	}
}
```

## src/rtt_sender.h
```c
/* SPDX-License-Identifier: Apache-2.0
 *
 * Streams full ADC windows over a dedicated RTT channel — see rtt_sender.c.
 */
#ifndef RTT_SENDER_H_
#define RTT_SENDER_H_

#include <stdint.h>
#include <stdbool.h>

/* Deliberately duplicate sampling_source.h's SM_ADC_NUM_CHANNELS /
 * SM_DELIVERY_RAW_CAPACITY rather than including that header — same
 * reasoning as ble_sender.h: this module shouldn't take a dependency on
 * the state machine's headers, sm_ble_bridge.c is the only place that
 * knows about both sides. Keep these in sync by hand if either changes. */
#define RTT_SM_NUM_CHANNELS    2
#define RTT_SM_MAX_RAW_SAMPLES 100

struct rtt_sm_window_info {
	uint32_t seq;
	uint32_t timestamp_ms;      /* k_uptime_get_32() when this window's last
				      * sample completed — see sampling_source.h's
				      * sm_buffer_meta.timestamp_ms */
	uint8_t  window_type;
	uint32_t sample_count;      /* window's true total (metadata) */
	bool     complete;
	uint8_t  raw_count;         /* how many of raw[] below are valid, <= RTT_SM_MAX_RAW_SAMPLES */
	int16_t  raw[RTT_SM_MAX_RAW_SAMPLES * RTT_SM_NUM_CHANNELS];   /* channel-interleaved */
};

/* Configures the dedicated RTT up-channel. Call once at boot, before any
 * rtt_sender_send_window() call. */
void rtt_sender_init(void);

/* Writes one whole window in a single SEGGER_RTT_Write() — unlike
 * ble_sender.c's BLE path, RTT isn't ATT-MTU-limited, so no
 * fragmentation is needed here even at RTT_SM_MAX_RAW_SAMPLES=100.
 * Non-blocking: if the host isn't reading fast enough and the RTT
 * up-buffer's ring is full, the whole write is silently dropped (never
 * partially written, never blocks the caller) — logged as a WRN, same
 * "never block the producer" policy as the rest of this pipeline. */
void rtt_sender_send_window(const struct rtt_sm_window_info *info);

#endif /* RTT_SENDER_H_ */
```

## src/sampling_source.c
```c
/* SPDX-License-Identifier: Apache-2.0
 *
 * Shared plumbing for the sampling_source interface: the per-window-type
 * rate/policy table and dispatch through whichever backend is registered.
 * See sampling_source.h and sampling_source_nrfx.c.
 */
#include "sampling_source.h"

#include <zephyr/kernel.h>
#include <zephyr/logging/log.h>

LOG_MODULE_REGISTER(sampling_source, LOG_LEVEL_INF);

/* SM_DELIVERY_RAW_CAPACITY (sampling_source.h) must cover a whole
 * ACTIVE_CAPTURE chunk or sm_core.c's sm_deliver_buffer() silently goes
 * back to truncating windows to a preview — this is the whole point of
 * having raised it, so catch a regression (e.g. someone bumping
 * SM_ACTIVITY_CHUNK_SAMPLES past 100 without also raising the capacity)
 * at build time instead of losing data silently again. */
BUILD_ASSERT(SM_DELIVERY_RAW_CAPACITY >= CONFIG_SM_ACTIVITY_CHUNK_SAMPLES,
	     "SM_DELIVERY_RAW_CAPACITY must cover a full ACTIVE_CAPTURE chunk");

/* HW-only, do not treat as validated — see sampling_source.h and
 * Kconfig help text for each symbol. */
const struct sm_window_profile sm_window_profiles[3] = {
	[WIN_HR]       = { .rate_hz = CONFIG_SM_SAMPLE_RATE_HR_HZ,
			    .buf_policy = BUF_SINGLE_BIG },
	[WIN_BP]       = { .rate_hz = CONFIG_SM_SAMPLE_RATE_BP_HZ,
			    .buf_policy = BUF_SINGLE_BIG },
	[WIN_ACTIVITY] = { .rate_hz = CONFIG_SM_SAMPLE_RATE_ACTIVITY_HZ,
			    .buf_policy = BUF_PING_PONG },
};

static const struct sampling_source_api *active_api;

void sampling_source_register(const struct sampling_source_api *api)
{
	active_api = api;
}

int sampling_source_start(const struct sampling_config *cfg)
{
	if (!active_api) {
		LOG_ERR("no sampling_source backend registered");
		return -ENODEV;
	}
	return active_api->start(cfg);
}

void sampling_source_stop(void)
{
	if (active_api) {
		active_api->stop();
	}
}

struct sm_buffer *sampling_source_get_buffer(enum sm_buffer_id buf_id)
{
	if (!active_api) {
		return NULL;
	}
	return active_api->get_buffer(buf_id);
}

struct sm_buffer *sampling_source_get_trailing_buffer(void)
{
	if (!active_api || !active_api->get_trailing_buffer) {
		return NULL;
	}
	return active_api->get_trailing_buffer();
}
```

## src/sampling_source.h
```c
/* SPDX-License-Identifier: Apache-2.0
 *
 * Sampling source interface for the state machine's logic layer.
 *
 * Exactly one backend is active at a time (sampling_source_register()).
 * This project only ever installs sampling_source_nrfx.c (real nrfx
 * SAADC) — ported from nrf5340_firmware, which also has a synthetic
 * software backend (sampling_source_synth.c) not carried over here.
 */
#ifndef SAMPLING_SOURCE_H_
#define SAMPLING_SOURCE_H_

#include <stdint.h>
#include <stdbool.h>

#include "sm_events.h"

/* Two TENG channels (AIN0/AIN1, see sampling_source_nrfx.c), always
 * sampled interleaved [S0 S1 | S0 S1 | ...]. Was temporarily widened to
 * 6 (AIN0-AIN5) to chase an AIN0/AIN1 channel-mapping bug — see
 * sampling_source_nrfx.c's channel table comment for the actual root
 * cause found (a wrong-enum-type bug, nothing to do with channel count)
 * — narrowed back to the 2 channels this project actually uses now that
 * it's fixed and confirmed on real hardware. */
#define SM_ADC_NUM_CHANNELS 2

enum sm_window_type {
	WIN_HR,        /* PULSE_WINDOW, heart-rate config */
	WIN_BP,        /* PULSE_WINDOW, blood-pressure/PTT config */
	WIN_ACTIVITY,  /* ACTIVE_CAPTURE config */
};

enum sm_buffer_policy {
	BUF_SINGLE_BIG,   /* PULSE_WINDOW: one big buffer, whole window at once */
	BUF_PING_PONG,    /* ACTIVE_CAPTURE: two buffers, continuous */
};

/* HW-only, do not treat as validated: real rates TBD once front-end and
 * PTT-resolution requirements are confirmed on real hardware. Backed by
 * Kconfig so they're tunable without touching this file — see Kconfig
 * symbols SM_SAMPLE_RATE_{HR,BP,ACTIVITY}_HZ. */
struct sm_window_profile {
	uint32_t rate_hz;
	enum sm_buffer_policy buf_policy;
};

/* Indexed by enum sm_window_type. Defined in sampling_source.c. */
extern const struct sm_window_profile sm_window_profiles[3];

struct sampling_config {
	enum sm_window_type window;
	/* Resolved from sm_window_profiles[window] by sm_core.c; carried
	 * here too so callers/logs don't have to re-look-up the table. */
	uint32_t rate_hz;
	enum sm_buffer_policy buf_policy;
};

/* ── PTT metadata ─────────────────────────────────────────────────────────
 *
 * Every buffer handed to the (not-yet-built) processing layer carries
 * this. per_channel_skew_us is the fixed, known offset of each channel's
 * sample instant from the scan's t0 — a constant of the sampling
 * hardware/config (single SAADC scan interleaving S1/S2/S3), not
 * something measured per-buffer.
 *
 * HW-only: the real skew constant is TBD once the real nrfx scan-mode
 * backend exists.
 */
struct sm_buffer_meta {
	enum sm_window_type window_type;
	uint32_t window_seq;                /* monotonic window counter */
	uint32_t rate_hz;
	uint32_t sample_count;              /* samples per channel in this buffer */
	uint32_t per_channel_skew_us[SM_ADC_NUM_CHANNELS];
	/* true = meaningful captured data (full ping-pong chunk, full single
	 * window, or the trailing partial chunk at a normal ACTIVE_CAPTURE
	 * exit). false = reserved for a preempted half pulse-window; per the
	 * transition table that case is never actually delivered, so this
	 * mostly documents intent for logging. */
	bool complete;
	/* k_uptime_get_32() at the moment this buffer's LAST sample
	 * completed (see sampling_source_nrfx.c's NRFX_SAADC_EVT_DONE
	 * handler) — device clock, milliseconds since boot, wraps at
	 * ~49.7 days (uint32_t ms). Added specifically because assumed
	 * sample-rate-based time reconstruction (PC-side tools) has
	 * repeatedly been wrong in this project's own history (see
	 * sampling_source_nrfx.c's trigger_hz note) — this lets any
	 * consumer measure real elapsed device time between windows
	 * instead of trusting a configured/assumed rate. */
	uint32_t timestamp_ms;
};

struct sm_buffer {
	struct sm_buffer_meta meta;
	int16_t *raw;   /* sample_count * SM_ADC_NUM_CHANNELS, channel-interleaved */
};

/* ── Delivery snapshot (sm_take_delivered_buffer()) ──────────────────────
 *
 * struct sm_buffer above holds a backend-owned pointer (buf->raw) into
 * storage the backend reuses/overwrites every fill cycle — fine for
 * immediate use inside sm_core.c's dispatch, unsafe to carry across a
 * queue a consumer drains later. sm_core.c's delivery queue instead
 * copies a bounded number of raw samples BY VALUE at delivery time.
 *
 * SM_DELIVERY_RAW_CAPACITY is a transport/preview cap, not a claim about
 * how large real captured windows are — it exists so a delivery snapshot
 * has a small, fixed size. meta.sample_count still reports the window's
 * true total;
 * raw_count reports how many of raw[] below are actually valid
 * (min(sample_count, SM_DELIVERY_RAW_CAPACITY)).
 */
/* Must stay >= CONFIG_SM_ACTIVITY_CHUNK_SAMPLES or every window silently
 * truncates again — see sampling_source.c's BUILD_ASSERT. Sized to 100
 * (== the default chunk size) specifically so ACTIVE_CAPTURE windows
 * carry every sample through to BLE, not just a preview: ble_sender.c
 * fragments a whole window across multiple notify packets instead of
 * capping what gets queued here. */
#define SM_DELIVERY_RAW_CAPACITY 100

struct sm_delivered_window {
	struct sm_buffer_meta meta;
	uint8_t raw_count;
	int16_t raw[SM_DELIVERY_RAW_CAPACITY * SM_ADC_NUM_CHANNELS];
};

/* ── Sampling source driver interface ────────────────────────────────────── */

struct sampling_source_api {
	int  (*start)(const struct sampling_config *cfg);
	void (*stop)(void);
	/* Only valid to call after the matching EV_BUF_READY has been
	 * consumed, or (get_trailing_buffer) right after stop(). */
	struct sm_buffer *(*get_buffer)(enum sm_buffer_id buf_id);
	/* Best-effort partial buffer as of the moment stop() was called —
	 * used for ACTIVE_CAPTURE's silence-timeout exit (take the trailing
	 * buffer). May return NULL if there is nothing to report. */
	struct sm_buffer *(*get_trailing_buffer)(void);
};

void sampling_source_register(const struct sampling_source_api *api);
int  sampling_source_start(const struct sampling_config *cfg);
void sampling_source_stop(void);
struct sm_buffer *sampling_source_get_buffer(enum sm_buffer_id buf_id);
struct sm_buffer *sampling_source_get_trailing_buffer(void);

#endif /* SAMPLING_SOURCE_H_ */
```

## src/sampling_source_nrfx.h
```c
/* SPDX-License-Identifier: Apache-2.0
 *
 * Real nrfx SAADC sampling_source backend — see sampling_source_nrfx.c
 * for the architecture and HW-only placeholder values.
 */
#ifndef SAMPLING_SOURCE_NRFX_H_
#define SAMPLING_SOURCE_NRFX_H_

/* Registers this backend as the active sampling_source_api implementation
 * and brings up the SAADC/TIMER/GPPI hardware (one-time: init, channel
 * config, offset calibration). Does not start sampling — that only
 * happens on sampling_source_start(). Real hardware only; do not call
 * this on native_sim (the SAADC/TIMER/GPPI peripherals it drives don't
 * exist there). */
void sampling_source_nrfx_install(void);

#endif /* SAMPLING_SOURCE_NRFX_H_ */
```

## src/sm_ble_bridge.c
```c
/* SPDX-License-Identifier: Apache-2.0
 *
 * Bridges sm_core.c's delivered windows to two live destinations:
 *   - rtt_sender.c: best-effort, drops under load if the host isn't
 *     reading fast enough (see rtt_sender.c) — fine for a wired
 *     monitoring channel.
 *   - ble_sender.c: real-time, queued for immediate transmission
 *     (ble_sender_queue_sm_window()) — drops the oldest queued window if
 *     BLE falls behind production rather than blocking, same
 *     backpressure policy as sm_core.c's own delivery queue. This
 *     project previously buffered a whole session in RAM and drained it
 *     over BLE afterward instead (see git history) — abandoned for
 *     hour-scale unattended captures, where RAM usage has to stay flat
 *     regardless of session length, which a full-session buffer cannot
 *     do.
 *
 *   sm_core.c (producer) --sm_take_delivered_buffer()--> [this thread]
 *     --rtt_sender_send_window()--> rtt_sender.c --> SEGGER_RTT_Write()
 *       (synchronous, non-blocking, live)
 *     --ble_sender_queue_sm_window()--> ble_sender.c's sm_tx_q (producer
 *       side, K_NO_WAIT) --> ble_sm_tx_thread_fn (ble_sender.c) --> NUS
 *
 * sm_take_delivered_buffer(K_FOREVER) here is a plain consumer read on
 * sm_core.c's queue — it does not block sm_core.c's own producer thread,
 * which posts with K_NO_WAIT regardless of whether anything is consuming.
 * Neither ble_sender_queue_sm_window() nor rtt_sender_send_window() ever
 * blocks either, so this bridge never blocks waiting on BLE/radio or
 * RTT/host.
 */
#include "sm_ble_bridge.h"
#include "sm_core.h"
#include "sampling_source.h"
#include "ble_sender.h"
#include "rtt_sender.h"

#include <zephyr/kernel.h>
#include <zephyr/logging/log.h>
#include <string.h>

LOG_MODULE_REGISTER(sm_ble_bridge, LOG_LEVEL_INF);

/* rtt_sender.h deliberately duplicates sampling_source.h's
 * SM_DELIVERY_RAW_CAPACITY/SM_ADC_NUM_CHANNELS rather than including that
 * header (see rtt_sender.h) — this catches them ever drifting apart
 * instead of silently truncating or overrunning. ble_sender.h has no
 * equivalent pair of constants to check: it takes struct
 * sm_delivered_window directly, so there is nothing to drift. */
BUILD_ASSERT(SM_DELIVERY_RAW_CAPACITY == RTT_SM_MAX_RAW_SAMPLES,
	     "sm_ble_bridge.c copies raw[] 1:1, sizes must match");
BUILD_ASSERT(SM_ADC_NUM_CHANNELS == RTT_SM_NUM_CHANNELS,
	     "sm_ble_bridge.c copies raw[] 1:1, channel counts must match");

static void bridge_thread_fn(void *a, void *b, void *c)
{
	ARG_UNUSED(a);
	ARG_UNUSED(b);
	ARG_UNUSED(c);

	struct sm_delivered_window win;

	while (1) {
		if (sm_take_delivered_buffer(&win, K_FOREVER) != 0) {
			continue;
		}

		struct rtt_sm_window_info rtt_info = {
			.seq = win.meta.window_seq,
			.timestamp_ms = win.meta.timestamp_ms,
			.window_type = (uint8_t)win.meta.window_type,
			.sample_count = win.meta.sample_count,
			.complete = win.meta.complete,
			.raw_count = win.raw_count,
		};

		memcpy(rtt_info.raw, win.raw,
		       (size_t)win.raw_count * SM_ADC_NUM_CHANNELS * sizeof(int16_t));

		rtt_sender_send_window(&rtt_info);

		ble_sender_queue_sm_window(&win);
	}
}

/* bridge_thread_fn's two locals (struct sm_delivered_window win + struct
 * rtt_sm_window_info rtt_info) are ~440 bytes EACH at
 * SM_DELIVERY_RAW_CAPACITY/RTT_SM_MAX_RAW_SAMPLES=100 * SM_ADC_NUM_CHANNELS/
 * RTT_SM_NUM_CHANNELS=2 — ~880 bytes combined. Has overflowed a smaller
 * stack before at higher channel counts (see git history) — left with
 * real margin above that. */
K_THREAD_DEFINE(sm_ble_bridge_tid, 3072, bridge_thread_fn, NULL, NULL, NULL, 7, 0, 0);

void sm_ble_bridge_init(void)
{
	LOG_INF("sm-to-BLE bridge ready (real-time)");
}
```

## src/sm_ble_bridge.h
```c
/* SPDX-License-Identifier: Apache-2.0
 *
 * Bridges sm_core.c's delivered windows to rtt_sender.c and ble_sender.c,
 * both live. See sm_ble_bridge.c.
 */
#ifndef SM_BLE_BRIDGE_H_
#define SM_BLE_BRIDGE_H_

/* K_THREAD_DEFINE already auto-starts the bridge thread at boot; this
 * just logs a "ready" line so main.c has an explicit, symmetrical call
 * site alongside the other *_init() calls. */
void sm_ble_bridge_init(void);

#endif /* SM_BLE_BRIDGE_H_ */
```

## src/sm_core.h
```c
/* SPDX-License-Identifier: Apache-2.0
 *
 * Sampling power state machine. Three states (DEEP_IDLE / PULSE_WINDOW /
 * ACTIVE_CAPTURE), single-threaded event consumer. Ported unmodified from
 * nrf5340_firmware; this project only ever drives it into ACTIVE_CAPTURE
 * and keeps it there for the whole session (see main.c and Kconfig's
 * SM_SILENCE_TIMEOUT_MS) — DEEP_IDLE/PULSE_WINDOW exist in the code but
 * are never reached because nothing here posts EV_PULSE_DUE.
 *
 * Does NOT do filtering/HR/BP/PTT computation and does NOT touch BLE.
 * Only decides when to sample, how, and where the resulting buffer goes
 * (sm_take_delivered_buffer()).
 */
#ifndef SM_CORE_H_
#define SM_CORE_H_

#include <zephyr/kernel.h>
#include <stdint.h>

#include "sm_events.h"
#include "sampling_source.h"

enum sm_state {
	SM_STATE_DEEP_IDLE,
	SM_STATE_PULSE_WINDOW,
	SM_STATE_ACTIVE_CAPTURE,
};

/* Register a sampling_source backend (e.g. sampling_source_nrfx_install())
 * BEFORE calling this. Starts the state-machine's consumer thread, enters
 * DEEP_IDLE cold (no pre-sampling), does not start sampling. */
int sm_core_init(void);

/* Post an abstract event into the state machine's queue. Thread- and
 * ISR-safe (K_NO_WAIT msgq put). Returns 0, or -ENOMSG if the queue is
 * full — treated as a programming-error / runaway-event-source signal,
 * not an expected condition at the event rates this design assumes. */
int sm_post_event(const struct sm_event *ev);

/* Introspection for tests / RTT diagnostics. */
enum sm_state sm_get_state(void);
uint32_t sm_get_overflow_count(void);

/* Mainly for tests: the state machine's consumer thread is asynchronous,
 * so a test that does sm_post_event() then immediately checks
 * sm_get_state() races the thread. Call this right after each
 * sm_post_event() (one event at a time — see sm_core.c for why) to
 * deterministically wait for that event's dispatch to finish before
 * asserting. Returns 0 if a dispatch completed within `timeout`,
 * -EAGAIN on timeout. */
int sm_wait_idle(k_timeout_t timeout);

/* Drain one delivered window (hand-off point to sm_ble_bridge.c). Blocks
 * up to `timeout`. Returns a value snapshot copied out at delivery time,
 * NOT a pointer into backend storage — the backend only owns 2 physical
 * buffers that it overwrites in place, so a queued pointer would go
 * stale the moment a later fill reuses that slot.
 * Raw sample data is bounded/truncated (struct sm_delivered_window's
 * raw[]/raw_count, capped at SM_DELIVERY_RAW_CAPACITY per channel) — a
 * transport preview, not the full window; meta.sample_count reports the
 * true total. */
int sm_take_delivered_buffer(struct sm_delivered_window *out, k_timeout_t timeout);

/* Test-only: reset all state back to a cold DEEP_IDLE (stops timers/
 * sampling, drains both queues, zeroes the overflow counter). No
 * legitimate production use — exists so Ztest cases can start from a
 * known state without a fresh process per test. */
void sm_reset_for_test(void);

#endif /* SM_CORE_H_ */
```
